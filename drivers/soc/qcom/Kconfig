## drivers/soc/qcom/Kconfig
```kconfig
# SPDX-License-Identifier: GPL-2.0-only
#
# QCOM Soc drivers
#
menu "Qualcomm SoC drivers"

config QCOM_AOSS_QMP
	tristate "Qualcomm AOSS Driver"
	depends on ARCH_QCOM || COMPILE_TEST
	depends on MAILBOX
	depends on COMMON_CLK && PM
	select PM_GENERIC_DOMAINS
	help
	  This driver provides the means of communicating with and controlling
	  the low-power state for resources related to the remoteproc
	  subsystems as well as controlling the debug clocks exposed by the Always On
	  Subsystem (AOSS) using Qualcomm Messaging Protocol (QMP).

config QCOM_COMMAND_DB
	tristate "Qualcomm Technologies, Inc. Command DB driver"
	depends on ARCH_QCOM || COMPILE_TEST
	depends on OF_RESERVED_MEM
	help
	  Command DB queries shared memory by key string for shared system
	  resources. Platform drivers that require to set state of a shared
	  resource on a RPM-hardened platform must use this database to get
	  SoC specific identifier and information for the shared resources.

config QCOM_CPUSS_SLEEP_STATS
	tristate "Qualcomm Technologies, Inc. (QTI) CPUSS sleep stats driver"
	depends on DEBUG_FS
	depends on QCOM_SCM
	help
	 Qualcomm Technologies, Inc. (QTI) CPUSS sleep stats driver to get
	 hardware LPM counts and residency for particular core/cluster
	 low power modes. This driver creates debugfs entry which provide
	 provision to read those counters.

config QCOM_QDSS_BRIDGE
	tristate "Configure bridge driver for QTI/Qualcomm Technologies, Inc. MDM"
	depends on MHI_BUS
	help
	  The driver will help route diag traffic from modem side over the QDSS
	  sub-system to USB on APSS side. The driver acts as a bridge between the
	  MHI and USB interface.
	  If unsure, say N.

config QCOM_MEM_OFFLINE
	tristate "Dynamic Memory Region Offline driver"
	depends on MEMORY_HOTPLUG
	help
	  Add support for DDR Self-Refresh power management through the dynamic
	  memory offline framework. This driver interfaces between the memory
	  hotplug subsystem and AOP which hot adds or removes memory blocks and
	  controls the start/stop of self-refresh of these DDR regions. This
	  helps reduce power consumption during idle mode of the system.
	  If unsure, say N

config BUG_ON_HW_MEM_ONLINE_FAIL
	bool "Trigger a BUG when HW memory online fails"
	depends on QCOM_MEM_OFFLINE
	help
	  Select this option if kernel should BUG when the hardware
	  onlining of memory hotplug blocks fails. This helps to catch
	  online failures much quicker and avoids the later side effects
	  of such memory online failures.
	  If unsure, say N

config OVERRIDE_MEMORY_LIMIT
	bool "Override memory limit set by the kernel boot parameter"
	depends on QCOM_MEM_OFFLINE
	help
	  Override any memory limit set by the kernel boot parameter with
	  limit set by mem-offline dt entry so that memory offline framework
	  can initialize remaining memory with movable pages for memory
	  hot-plugging.
	  If unsure, say N

source "drivers/soc/qcom/mem_buf/Kconfig"

config QCOM_CPR
	tristate "QCOM Core Power Reduction (CPR) support"
	depends on ARCH_QCOM && HAS_IOMEM
	select PM_OPP
	select REGMAP
	help
	  Say Y here to enable support for the CPR hardware found on Qualcomm
	  SoCs like QCS404.

	  This driver populates CPU OPPs tables and makes adjustments to the
	  tables based on feedback from the CPR hardware. If you want to do
	  CPUfrequency scaling say Y here.

	  To compile this driver as a module, choose M here: the module will
	  be called qcom-cpr

config SHOW_SUSPEND_EPOCH
	tristate "Show epoch values in suspend resume cycles"
	depends on ARCH_QCOM
	help
	  Show epoch values when device enter and exit out of suspend
	  and resume. These epoch values are useful to know how long
	  the device is in suspend state. These values can be used to
	  synchronize various subsystem timestamps and have an unique
	  timestamp to correlate between various subsystems.

config QCOM_GENI_SE
	tristate "QCOM GENI Serial Engine Driver"
	depends on ARCH_QCOM || COMPILE_TEST
	help
	  This driver is used to manage Generic Interface (GENI) firmware based
	  Qualcomm Technologies, Inc. Universal Peripheral (QUP) Wrapper. This
	  driver is also used to manage the common aspects of multiple Serial
	  Engines present in the QUP.

config OVERRIDE_MEMORY_LIMIT
	bool "Override memory limit set by the kernel boot parameter"
	depends on QCOM_MEM_OFFLINE
	help
	  Override any memory limit set by the kernel boot parameter with
	  limit set by mem-offline dt entry so that memory offline framework
	  can initialize remaining memory with movable pages for memory
	  hot-plugging.
	  If unsure, say N

config MSM_SPSS_UTILS
	depends on QCOM_SPSS
	tristate "Secure Processor Utilities"
	help
	  spss-utils driver selects Secure Processor firmware file name.name
	  The firmware file name for dev, test or production is selected
	  based on two fuses.fuses
	  Different file name is used for differnt SPSS HW versions,versions
	  because the SPSS firmware size is too small to support multiple
	  HW versions.

config MSM_QBT_HANDLER
	tristate "Event Handler for QTI Ultrasonic Fingerprint Sensor"
	help
	  This driver acts as a interrupt handler, where the interrupt is generated
	  by the QTI Ultrasonic Fingerprint Sensor. It queues the events for each
	  interrupt in an event queue and notifies the userspace to read the events
	  from the queue. It also creates an input device to send key events such as
	  KEY_POWER, KEY_HOME.

config QCOM_PROXY_OF_CONSUMER
	tristate "Qualcomm Technologies, Inc. OF proxy consumer driver"
	help
	  A target may contain multiple defconfigs, but only one device-tree
	  configuration. Such a target may have device-drivers that are
	  only enabled in a particular defconfig, while disabled in the
	  others. For the kernel that boots up with disabled configuration,
	  since the device-tree node exists, the of_devlink logic expects
	  the driver to be probed, which is not possible. As a result, the
	  sync-state remains incomplete.
	  This proxy consumer driver shows a proxy-presence of the main
	  driver to satisfy the sync-state.

config QCOM_GSBI
	tristate "QCOM General Serial Bus Interface"
	depends on ARCH_QCOM || COMPILE_TEST
	select MFD_SYSCON
	help
	  Say y here to enable GSBI support.  The GSBI provides control
	  functions for connecting the underlying serial UART, SPI, and I2C
	  devices to the output pins.

config QCOM_MSM_IPCC
	tristate "Qualcomm Technologies, Inc. IPCC driver"
	depends on MAILBOX
	help
	  Qualcomm Technologies, Inc. IPCC driver for MSM devices. The drivers
	  acts as an interrupt controller for the clients interested in
	  talking to the IPCC (inbound-communication). On the other hand, the
	  driver also provides a mailbox channel for outbound-communications.
	  Say Y here to compile the driver as a part of kernel or M to compile
	  as a module.

config QCOM_TLMM_VM_IRQCHIP
       tristate "Qualcomm Technologies, Inc. TLMM VM irqchip driver"
       help
         Qualcomm Technologies, Inc. TLMM VM irqchip driver for MSM devices. The
         driver acts as a parent interrupt controller for tlmm driver for VMs.
         Say Y here to compile the driver as a part of kernel or M to compile
         as a module.

config QCOM_GIC_INTERRUPT_ROUTING
       tristate "Qualcomm Technologies, Inc. GIC Interrupt Routing driver"
       depends on ARM_GIC_V3
       help
         Qualcomm Technologies, Inc. GIC interrupt routing driver for MSM devices.
         The driver manages interrupt routing for shared peripheral interrupts.
         Say Y here to compile the driver as a part of kernel or M to compile
         as a module.

config GH_TLMM_VM_MEM_ACCESS
	tristate "Qualcomm Technologies, Inc. TLMM VM mem access driver"
	depends on GH_RM_DRV
	help
         Qualcomm Technologies, Inc. TLMM VM mem access driver for MSM devices.
         The drivers provides initial gpio memory access to VM.
         Say Y here to compile the driver as a part of kernel or M to compile
         as a module.

config QCOM_RIMPS
	tristate "Qualcomm Technologies, Inc. Rimps driver"
	depends on MAILBOX
	help
	 Qualcomm Technologies, Inc. RIMPS driver for MSM devices. This driver
	 acts as a mailbox controller to do doorbell between Apss and Rimps
	 subsystem. Say yes here to enable rx and tx channel between both
	 the subsystems.
	 If unsure, say n.

config QCOM_LLCC
	tristate "Qualcomm Technologies, Inc. LLCC driver"
	depends on ARCH_QCOM || COMPILE_TEST
	select REGMAP_MMIO
	help
	  Last Level Cache Controller(LLCC) driver for platforms such as,
	  SDM845. This provides interfaces to clients that use the LLCC.
	  Say yes here to enable LLCC slice driver.

config QCOM_LLCC_PERFMON
	tristate "Qualcomm Technologies, Inc. LLCC Perfmon driver"
	depends on QCOM_LLCC
	help
	  This option enables driver for LLCC Performance monitor block. Using
	  this various events in different LLCC sub ports can be monitored.
	  This is used for performance and debug activity and exports sysfs
	  interface. sysfs interface is used to configure and dump the LLCC
	  performance events.

config QCOM_SPAD_PERFMON
	tristate "Qualcomm Technologies, Inc. SPAD Perfmon driver"
	depends on QCOM_LLCC
	help
	  This option enables driver for SPAD Performance monitor block. Using
	  this various events in SPAD LPI LB block can be monitored.
	  Exports sysfs interface to configure and dump the SPAD performance
	  events.

config QCOM_KRYO_L2_ACCESSORS
	bool
	depends on ARCH_QCOM && ARM64 || COMPILE_TEST

config QCOM_MDT_LOADER
	tristate
	select QCOM_SCM

config QCOM_OCMEM
	tristate "Qualcomm On Chip Memory (OCMEM) driver"
	depends on ARCH_QCOM
	select QCOM_SCM
	help
	  The On Chip Memory (OCMEM) allocator allows various clients to
	  allocate memory from OCMEM based on performance, latency and power
	  requirements. This is typically used by the GPU, camera/video, and
	  audio components on some Snapdragon SoCs.

config QPNP_PBS
	tristate "PBS trigger support for QPNP PMIC"
	depends on SPMI
	help
	  This driver supports configuring software PBS trigger event through PBS
	  RAM on Qualcomm Technologies, Inc. QPNP PMICs. This module provides
	  the APIs to the client drivers that wants to send the PBS trigger
	  event to the PBS RAM.

config QCOM_PDR_HELPERS
	tristate
	select QCOM_QMI_HELPERS

config QCOM_PANIC_ON_PDR_NOTIF_TIMEOUT
	bool "Trigger kernel panic when PDR notification timeout expires"
	help
	  This is a debug feature where a kernel panic is triggered when
	  pdr notification to the APPS client is taking too long. This scneario
	  can happen if the one of notifier gets stuck and due to which subsystem
	  did not get ack back from APPS in time and trigger timeout panic.
	  So, trigger a kernel panic in APPS if PDR notifications is taking
	  too long.

config PDR_INDICATION_NOTIF_TIMEOUT
	int "Pdr notifications timeout in ms"
	default 3000
	help
	  The amount of time, in milliseconds, that should elapse between
	  the start and end of notifications, before a warning
	  is emitted.

config QCOM_PDR_MONITOR
	tristate "Qualcomm Protection Domain Restart Monitor"
	depends on QCOM_PDR_HELPERS
	depends on QCOM_SMEM
	help
	  This driver monitors Protection Domain (PD) state changes on
	  Qualcomm SoCs and logs symbolized stack traces in case of PD down
	  for debugging purposes. It provides visibility into PD events
	  that may affect subsystem stability.

	  Say Y here if you need to debug PD-related issues on Qualcomm
	  platforms.

config MSM_PIL
	tristate "Peripheral image loader"
	select FW_LOADER
	help
	  Some peripherals' firmware need to be loaded into memory before
	  they can be brought out of reset. The Peripheral Image Loader (PIL)
	  framework is used to achive this. The driver relays the lower-level
	  functionalities such as, authenticating the images, performing the
	  reset of the peripheral, and so on to the drivers that are registered
	  with it.

	  Say 'y' or 'm' to support these devices.

config MSM_POWER_STATE
	tristate "Power State driver support for Deep Sleep and Hibernate"
	help
	  This option enables Power State Driver which is the kernel component
	  for supporting deep sleep and hibernate. Create a power_state device
	  node for user space communication. User space client can open device
	  node for communication required for handling deep sleep and hibernate
	  modes.

config DEEPSLEEP
	bool "Deep Sleep or Suspend-to-RAM sleep state"
	depends on MSM_POWER_STATE
	help
	  Set this option to enable Deep Sleep. Deep Sleep is Suspend-to-RAM
	  sleep state, in which entire system is put in a low-power state,
	  except for memory, so that exit from this state can happen in shorter
	  duration.

config MSM_SUBSYSTEM_RESTART
	tristate "MSM Subsystem Restart"
	select MSM_PIL
	select QCOM_QMI_HELPERS
	help
	  This option enables the MSM subsystem restart framework.

	  The MSM subsystem restart framework provides support to boot,
	  shutdown, and restart subsystems with a reference counted API.
	  It also extends the APIs to add support for MSM System Monitor
	  using the QMI layer. These APIs may be used for sending events
	  or passing commands.
	  Moreover, the framework also notifies userspace of transitions
	  between these states via sysfs.

config SETUP_SSR_NOTIF_TIMEOUTS
	bool "Set timeouts on SSR sysmon notifications and notifier callbacks"
	help
	  Setup timers prior to initiating communication between
	  subsystems through sysmon, and prior to sending notifications
	  to drivers in the kernel that have registered callbacks with the
	  subsystem notifier framework for a particular subsystem. This
	  is a debugging feature.

config SSR_SYSMON_NOTIF_TIMEOUT
	depends on SETUP_SSR_NOTIF_TIMEOUTS
	int "SSR Sysmon notifications timeout in ms"
	default 10000
	help
	  The amount of time, in milliseconds, that should elapse between
	  the start and end of sysmon SSR notifications, before a warning
	  is emitted.

config SSR_SUBSYS_NOTIF_TIMEOUT
	depends on SETUP_SSR_NOTIF_TIMEOUTS
	int "SSR Subsystem notifier timeout in ms"
	default 10000
	help
	  The amount of time, in milliseconds, that should elapse between
	  the start and end of SSR notifications through the subsystem
	  notifier, before a warning is emitted.

config PANIC_ON_SSR_NOTIF_TIMEOUT
	bool "Trigger kernel panic when notification timeout expires"
	depends on SETUP_SSR_NOTIF_TIMEOUTS
	help
	  This is a debug feature where a kernel panic is triggered when
	  communication between subsystems through sysmon is taking too
	  long. This scneario can happen if the peripheral has died and
	  is no longer responsive.
	  Also trigger a kernel panic if invoking the callbacks registered
	  with a particular subsystem's notifications by the subsystem
	  notifier framework is taking too long.

config MSM_PIL_SSR_GENERIC
	tristate "MSM Subsystem Boot Support"
	depends on MSM_SUBSYSTEM_RESTART
	help
	  Support for booting and shutting down MSM Subsystem processors.
	  This driver also monitors the SMSM status bits and the watchdog
	  interrupt for the subsystem and restarts it on a watchdog bite
	  or a fatal error. Subsystems include LPASS, Venus, VPU, WCNSS and
	  BCSS.

config MSM_SERVICE_LOCATOR
	tristate "Service Locator"
	select QCOM_QMI_HELPERS
	help
	  The Service Locator provides a library to retrieve location
	  information given a service identifier. Location here translates
	  to what process domain exports the service, and which subsystem
	  that process domain will execute in.

config MSM_SERVICE_NOTIFIER
	tristate "Service Notifier"
	depends on MSM_SERVICE_LOCATOR && MSM_SUBSYSTEM_RESTART
	help
	  The Service Notifier provides a library for a kernel client to
	  register for state change notifications regarding a remote service.
	  A remote service here refers to a process providing certain services
	  like audio, the identifier for which is provided by the service
	  locator.

config QCOM_RAMDUMP
	tristate "Qualcomm Technologies, Inc. Ramdump driver"
	default n
	help
	  This option enables the QTI ramdump driver. The ramdump driver
	  provides APIs to collect ramdumps which can be extracted from
	  userspace. Say 'Y' here to enable this driver. It's safe to say
	  'N' here if you don't plan on collecting ramdumps.

config MSM_BOOT_STATS
	tristate "Use MSM boot stats reporting"
	help
	  Use this to report msm boot stats such as bootloader throughput,
	  display init, total boot time.
	  This figures are reported in mpm sleep clock cycles and have a
	  resolution of 31 bits as 1 bit is used as an overflow check.

config QCOM_QMI_HELPERS
	tristate
	depends on NET

source "drivers/soc/qcom/memshare/Kconfig"

config QCOM_QFPROM_SYS
	tristate "Qualcomm Technologies, Inc. QFPROM_SYS driver "
	depends on QCOM_QFPROM
	help
	  Qualcomm Technologies, Inc. QFPROM_SYS driver. The QFPROM SYS driver
	  provides access to the child nodes of QFPROM to user space. The cell
	  values are exported as sysfs entries.

	  Say y here to enable QFPROM SYS support.

config QCOM_RMTFS_MEM
	tristate "Qualcomm Remote Filesystem memory driver"
	depends on ARCH_QCOM
	select QCOM_SCM
	help
	  The Qualcomm remote filesystem memory driver is used for allocating
	  and exposing regions of shared memory with remote processors for the
	  purpose of exchanging sector-data between the remote filesystem
	  service and its clients.

	  Say y here if you intend to boot the modem remoteproc.

config MSM_CORE_HANG_DETECT
	tristate "MSM Core Hang Detection Support"
	help
	  This enables the core hang detection module. It causes SoC
	  reset on core hang detection and collects the core context
	  for hang. By using sysfs entries core hang detection can be
	  enabled or disabled dynamically.

config QCOM_RPMH
	tristate "Qualcomm RPM-Hardened (RPMH) Communication"
	depends on ARCH_QCOM || COMPILE_TEST
	depends on (QCOM_COMMAND_DB || !QCOM_COMMAND_DB)
	help
	  Support for communication with the hardened-RPM blocks in
	  Qualcomm Technologies Inc (QTI) SoCs. RPMH communication uses an
	  internal bus to transmit state requests for shared resources. A set
	  of hardware components aggregate requests for these resources and
	  help apply the aggregated state on the resource.

config QCOM_RPMHPD
	tristate "Qualcomm RPMh Power domain driver"
	depends on QCOM_RPMH && QCOM_COMMAND_DB
	help
	  QCOM RPMh Power domain driver to support power-domains with
	  performance states. The driver communicates a performance state
	  value to RPMh which then translates it into corresponding voltage
	  for the voltage rail.

config QCOM_RUN_QUEUE_STATS
       tristate "Enable collection and exporting of QTI Run Queue stats to userspace"
       help
        This option enables the driver to periodically collecting the statistics
        of kernel run queue information and calculate the load of the system.
        This information is exported to usespace via sysfs entries and userspace
        algorithms uses info and decide when to turn on/off the cpu cores.

config QCOM_RPMPD
	tristate "Qualcomm RPM Power domain driver"
	depends on PM
	depends on QCOM_SMD_RPM
	help
	  QCOM RPM Power domain driver to support power-domains with
	  performance states. The driver communicates a performance state
	  value to RPM which then translates it into corresponding voltage
	  for the voltage rail.

config QCOM_SMEM
	tristate "Qualcomm Shared Memory Manager (SMEM)"
	depends on ARCH_QCOM || COMPILE_TEST
	depends on HWSPINLOCK
	help
	  Say y here to enable support for the Qualcomm Shared Memory Manager.
	  The driver provides an interface to items in a heap shared among all
	  processors in a Qualcomm platform.

config QCOM_SMD_RPM
	tristate "Qualcomm Resource Power Manager (RPM) over SMD"
	depends on ARCH_QCOM || COMPILE_TEST
	depends on RPMSG
	help
	  If you say yes to this option, support will be included for the
	  Resource Power Manager system found in the Qualcomm 8974 based
	  devices.

	  This is required to access many regulators, clocks and bus
	  frequencies controlled by the RPM on these devices.

	  Say M here if you want to include support for the Qualcomm RPM as a
	  module. This will build a module called "qcom-smd-rpm".

config QCOM_MEMORY_DUMP_V2
	tristate "QCOM Memory Dump V2 Support"
	help
	  This enables memory dump feature. It allows various client
	  subsystems to register respective dump regions. At the time
	  of deadlocks or cpu hangs these dump regions are captured to
	  give a snapshot of the system at the time of the crash.

config MSM_REMOTEQDSS
	bool "Allow debug tools to enable events on other processors"
	depends on QCOM_SCM && DEBUG_FS
	help
	  Other onchip processors/execution environments may support debug
	  events. Provide a sysfs interface for debug tools to dynamically
	  enable/disable these events. Interface located in
	  /sys/class/remoteqdss.

config QCOM_SMEM_STATE
	bool

config QCOM_SMP2P
	tristate "Qualcomm Shared Memory Point to Point support"
	depends on MAILBOX
	depends on QCOM_SMEM
	select QCOM_SMEM_STATE
	select IRQ_DOMAIN
	help
	  Say yes here to support the Qualcomm Shared Memory Point to Point
	  protocol.

config QCOM_SMSM
	tristate "Qualcomm Shared Memory State Machine"
	depends on QCOM_SMEM
	select QCOM_SMEM_STATE
	select IRQ_DOMAIN
	help
	  Say yes here to support the Qualcomm Shared Memory State Machine.
	  The state machine is represented by bits in shared memory.

config QCOM_SOCINFO
	tristate "Qualcomm socinfo driver"
	depends on QCOM_SMEM
	select SOC_BUS
	help
	 Say yes here to support the Qualcomm socinfo driver, providing
	 information about the SoC to user space.

config QCOM_SOC_SLEEP_STATS
	tristate "Qualcomm Technologies, Inc. (QTI) SoC sleep stats driver"
	depends on ARCH_QCOM || COMPILE_TEST
	help
	  Qualcomm Technologies, Inc. (QTI) SoC sleep stats driver to read
	  the shared memory exported by the remote processor related to
	  various SoC level low power modes statistics and export to debugfs
	  interface.

config QCOM_ADSP_SLEEPMON
	tristate "ADSP sleep monitor"
	depends on QCOM_SMEM
	help
	   This driver tracks ADSP sleep statistics while interfacing with
	   different userspace clients making use of ADSP. Based on the
	   activity notifications from these userspace clients, the driver
	   detects and logs sleep violations from ADSP subsystem. The driver
	   uses master stats from ADSP subsystem stored in SMEM.

config QCOM_WCNSS_CTRL
	tristate "Qualcomm WCNSS control driver"
	depends on ARCH_QCOM || COMPILE_TEST
	depends on RPMSG
	help
	  Client driver for the WCNSS_CTRL SMD channel, used to download nv
	  firmware to a newly booted WCNSS chip.

config QCOM_DCC_V2
       tristate "Qualcomm Technologies Data Capture and Compare enigne support for V2"
       help
         This option enables driver for Data Capture and Compare engine. DCC
         driver provides interface to configure DCC block and read back
         captured data from DCC's internal SRAM.

config QCOM_MINIDUMP
	tristate "QCOM Minidump Support"
	depends on QCOM_SMEM
	help
	  This enables minidump feature. It allows various clients to
	  register to dump their state at system bad state (panic/WDT,etc.,).
	  Minidump would dump all registered entries, only when DLOAD mode
	  is enabled.

config QCOM_VA_MINIDUMP
	tristate "QCOM VA Minidump Support"
	depends on QCOM_MINIDUMP
	help
	  This enables minidump feature for registering dynamic
	  data structures. It supports VA based registration
	  with minidump, which is made into an ELF. The region
	  for ELF is registered with legacy minidump.

config QCOM_DYN_MINIDUMP_STACK
	bool "QTI Dynamic Minidump Stack Registration Support"
	depends on QCOM_MINIDUMP
	help
	  This enables minidump dynamic current stack registration feature.
	  It allows current task stack to be available in minidump, for cases
	  where CPU is unable to register it from IPI_CPU_STOP. The stack data
	  can be used to unwind stack frames.

config QCOM_MINIDUMP_FTRACE
	bool "QCOM Minidump Support"
	depends on QCOM_MINIDUMP
	help
	  This enables ftrace buffer registration in minidump table.
	  On oops, ftrace content will be copied to that buffer.
	  This way ftrace buffer content becomes a part of minidump dump
	  collection.

config QCOM_MINIDUMP_PANIC_DUMP
	bool "QCOM Minidump Panic dumps Support"
	depends on QCOM_MINIDUMP
	help
	  This enables collection of debug information like runqueue
	  statistics etc. on panic in minidump. It dumps current, CFS,
	  and RT runqueue tasks running on each cpu. This help in
	  knowing the tasks running, pending, hogging on cpu during
	  panic.

config QCOM_MINIDUMP_PANIC_CPU_CONTEXT
	bool "QCOM Minidump Panic dumps Support"
	depends on ARM64 && QCOM_MINIDUMP_PANIC_DUMP
	help
	  This enables cpu context collection in minidump table,
	  on panic.

config QCOM_MINIDUMP_PSTORE
	bool "QCOM Minidump Pstore dumps Support"
	depends on ARM64 && QCOM_MINIDUMP
	help
	  This enables pstore registration in minidump table.
	  Here, pstore framework dump logs like pmsg, dmesg,
	  console ftrace etc. in the given carve-out memory
	  (non-volatile memory) and during warm reboot these
	  dump will be copied outside the system on panic.

config MINIDUMP_MAX_ENTRIES
	int "Minidump Maximum num of entries"
	default 200
	depends on QCOM_MINIDUMP
	help
	  This defines maximum number of entries to be allocated for application
	  subsytem in Minidump table.

config QCOM_MICRODUMP
	tristate "Qualcomm Technologies, Inc. Microdump Support"
	depends on QCOM_RAMDUMP
	depends on QCOM_SMEM
	help
	  This enables microdump feature. It collects
	  crash data from SMEM whenever modem subsytem
	  crashes and stores it under /devcd to expose
	  to user space.

config QCOM_APR
	tristate "Qualcomm APR Bus (Asynchronous Packet Router)"
	depends on ARCH_QCOM || COMPILE_TEST
	depends on RPMSG
	depends on NET
	select QCOM_PDR_HELPERS
	help
	  Enable APR IPC protocol support between
	  application processor and QDSP6. APR is
	  used by audio driver to configure QDSP6
	  ASM, ADM and AFE modules.

endmenu
```
